## sdkconfig.defaults
```kconfig
# Ball Balancer — sdkconfig defaults for ESP32-S3 DevKitC-1
CONFIG_FREERTOS_HZ=1000
CONFIG_LOG_DEFAULT_LEVEL_INFO=y
CONFIG_ESP_MAIN_TASK_STACK_SIZE=4096
CONFIG_ESPTOOLPY_FLASHSIZE="4MB"

# Console (saida E comandos) pelo conector USB NATIVO (USB-Serial-JTAG).
# A placa enumera como USB-Serial/JTAG; assim o que voce digita no monitor
# chega ao firmware e a telemetria sai pelo mesmo cabo.
CONFIG_ESP_CONSOLE_USB_SERIAL_JTAG=y
```
